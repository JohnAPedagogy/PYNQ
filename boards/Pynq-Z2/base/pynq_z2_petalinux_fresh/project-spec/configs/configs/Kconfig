## boards/Pynq-Z2/base/pynq_z2_petalinux_fresh/project-spec/configs/configs/Kconfig
```kconfig
mainmenu "PetaLinux System Configuration"
config SUBSYSTEM_TYPE_LINUX
        bool
        default y
        select SYSTEM_ZYNQ

config SYSTEM_ZYNQ
        bool "ZYNQ Configuration"
        help
          ZYNQ Configuration for the project.
          All these config options will be in /home/its/tools/yocto/petal/pynq/boards/Pynq-Z2/base/pynq_z2_petalinux_fresh/project-spec/configs/config

config SUBSYSTEM_DISTRO_PETALINUX
        bool
        default y
        help

source /home/its/tools/yocto/petal/pynq/boards/Pynq-Z2/base/pynq_z2_petalinux_fresh/project-spec/configs/configs/Kconfig.main
```

## boards/Pynq-Z2/base/pynq_z2_petalinux_fresh/project-spec/configs/configs/Kconfig.main
```kconfig
# Copyright (C) 2021-2022, Xilinx, Inc.  All rights reserved.
# Copyright (C) 2022-2024, Advanced Micro Devices, Inc.  All rights reserved.
#
# SPDX-License-Identifier: MIT
#

choice
	prompt "Subsystem Architecture (NO EDIT!)"
	default SUBSYSTEM_ARCH_ARM
	help
	  This option is to control the processor targeted by System Configuration.
	  WARNING: Do not edit this option.

config SUBSYSTEM_ARCH_AARCH64
	bool "aarch64"
	help
	  Choose this option to specify AARCH64 as the SUBSYSTEM architecture

config SUBSYSTEM_ARCH_ARM
	bool "arm"
	help
	  Choose this option to specify ARM as the SUBSYSTEM architecture

config SUBSYSTEM_ARCH_MICROBLAZE
	bool "microblaze"
	help
	  Choose this option to specify MicroBlaze as the SUBSYSTEM architecture
endchoice

config SUBSYSTEM_ENDIAN_LITTLE
	bool
	default y

if SUBSYSTEM_SDT_FLOW

source /home/its/tools/yocto/petal/pynq/boards/Pynq-Z2/base/pynq_z2_petalinux_fresh/project-spec/configs/configs/Kconfig.bootcompselection

endif

if SUBSYSTEM_DISTRO_PETALINUX

source /home/its/tools/yocto/petal/pynq/boards/Pynq-Z2/base/pynq_z2_petalinux_fresh/project-spec/configs/configs/Kconfig.linuxcompselection

source /home/its/tools/yocto/petal/pynq/boards/Pynq-Z2/base/pynq_z2_petalinux_fresh/project-spec/configs/configs/Kconfig.autoconfigsettings

endif

source /home/its/tools/yocto/petal/pynq/boards/Pynq-Z2/base/pynq_z2_petalinux_fresh/project-spec/configs/configs/Kconfig.syshw

source /home/its/tools/yocto/petal/pynq/boards/Pynq-Z2/base/pynq_z2_petalinux_fresh/project-spec/configs/configs/Kconfig.dtgsettings

source /home/its/tools/yocto/petal/pynq/boards/Pynq-Z2/base/pynq_z2_petalinux_fresh/project-spec/configs/configs/Kconfig.bootcompconfigurations

if SUBSYSTEM_DISTRO_PETALINUX

source /home/its/tools/yocto/petal/pynq/boards/Pynq-Z2/base/pynq_z2_petalinux_fresh/project-spec/configs/configs/Kconfig.imagepkgconfigurations

endif

source /home/its/tools/yocto/petal/pynq/boards/Pynq-Z2/base/pynq_z2_petalinux_fresh/project-spec/configs/configs/Kconfig.yoctobuildsettings
```
